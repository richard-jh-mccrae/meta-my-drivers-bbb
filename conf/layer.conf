## conf/layer.conf
```bitbake
# We have a conf and classes directory, add to BBPATH
BBPATH .= ":${LAYERDIR}"

BBFILES:prepend = "${LAYERDIR}/recipes-*/*/*.bb \
                 ${LAYERDIR}/recipes-*/*/*.bbappend"

BBFILE_COLLECTIONS += "meta-my-drivers-bbb"
BBFILE_PATTERN_meta-my-drivers-bbb = "^${LAYERDIR}/"
BBFILE_PRIORITY_meta-my-drivers-bbb = "6"

LAYERDEPENDS_meta-my-drivers-bbb = "core"
LAYERSERIES_COMPAT_meta-my-drivers-bbb = "kirkstone"

# COMPATIBLE_MACHINE = '(cyclone5)'
```
